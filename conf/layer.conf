## conf/layer.conf
```bitbake
# We have a conf and classes directory, add to BBPATH
BBPATH .= ":${LAYERDIR}"

# We have recipes-* directories, add to BBFILES
BBFILES += "${LAYERDIR}/recipes-*/*/*.bb \
            ${LAYERDIR}/recipes-*/*/*.bbappend"

BBFILE_COLLECTIONS += "meta-rpi-robot"
BBFILE_PATTERN_meta-rpi-robot = "^${LAYERDIR}/"
BBFILE_PRIORITY_meta-rpi-robot = "10"

LAYERDEPENDS_meta-rpi-robot = "qt5-layer \
                        ros2-humble-layer \
                        "
LAYERSERIES_COMPAT_meta-rpi-robot = "kirkstone"
```
